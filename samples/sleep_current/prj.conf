## CMakeLists.txt
```
#
# Copyright (c) 2022 Nordic Semiconductor ASA
#
# SPDX-License-Identifier: LicenseRef-Nordic-5-Clause
#
cmake_minimum_required(VERSION 3.20.0)

find_package(Zephyr REQUIRED HINTS $ENV{ZEPHYR_BASE})
project(peripheral_power_profiling)

project(sleep_current)

# The hack to allow using scheduler API

target_sources(app PRIVATE src/main.c)
```

## prj.conf
```kconfig
CONFIG_ASSERT=y

# Disable output on UART terminal
CONFIG_SERIAL=n
CONFIG_UART_CONSOLE=n
CONFIG_LOG=n
CONFIG_CONSOLE=n

# Disable pin toggles
CONFIG_GPIO=n
```

## src/main.c
```c
/*
 * Copyright (c) Nordic Semiconductor ASA. All Rights Reserved.
 *
 * The information contained herein is confidential property of Nordic Semiconductor ASA.
 * The use, copying, transfer or disclosure of such information is prohibited except by
 * express written agreement with Nordic Semiconductor ASA.
 */

#include <stdint.h>
#include "common.h"

int main(void)
{

	return 0;
}
```
