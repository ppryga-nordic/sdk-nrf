## Kconfig
```
#
# Copyright (c) 2020 Nordic Semiconductor
#
# SPDX-License-Identifier: LicenseRef-Nordic-5-Clause
#

menu "NFC Paring configuration"

choice NFC_TAG_CONNECTION_HANDOVER_ROLE
	prompt "Connection Handover Tag role"
	default NFC_TAG_CH_SELECTOR

config NFC_TAG_CH_SELECTOR
	bool "Connection Handover selector role"
	help
	  NFC Tag is Connection Handover selector device. The Handover Selector
	  is an NFC Forum Device that constructs and replies to a
	  Handover Select Message as a result of a previously received
	  Handover Request Message, or an NFC Tag Device that provides a
	  pre-set Handover Select Message for reading.For more details
	  check NFC Forum Connection Handover 1.5 2.2

config NFC_TAG_CH_REQUESTER
	bool "Connection Handover requester role"
	help
	  NFC Tag is Connection Handover requester device. The Handover Requester
	  is an NFC Forum Device that begins the Handover Protocol by issuing
	  a Handover Request Message to another NFC Forum Device. For more
	  details check NFC Forum Connection Handover 1.5 2.2.

endchoice

config SETTINGS
	default y

config ZMS
	default y if (SOC_FLASH_NRF_RRAM || SOC_FLASH_NRF_MRAM)

config NVS
	default y if !(SOC_FLASH_NRF_RRAM || SOC_FLASH_NRF_MRAM)

endmenu

menu "Advertising and user confirm"

config PERIPH_NFC_PAIRING_ADV_ON_BOOT
	bool "Start connectable advertising at boot"
	default y
	help
	  When enabled, the device advertises after Bluetooth initialization.
	  Use this when NFC must not trigger advertising (see
	  PERIPH_NFC_PAIRING_ADV_ON_NFC).

config PERIPH_NFC_PAIRING_ADV_ON_NFC
	bool "Start advertising when the NFC tag is read"
	default n
	help
	  Original sample behavior: connectable advertising starts after an NFC
	  poller reads the NDEF message. Disable to use NFC only for OOB data
	  exchange while advertising is controlled separately.

config PERIPH_NFC_PAIRING_ADV_ON_TNEP_OOB
	bool "Start advertising after TNEP OOB data exchange"
	default n
	depends on !PERIPH_NFC_PAIRING_ADV_ON_NFC
	help
	  If enabled, advertising starts when OOB data is received over TNEP.
	  Leave disabled to avoid advertising changes during NFC handover.

config PERIPH_NFC_PAIRING_DK_BUTTON_CONFIRM
	bool "DK Button 1 confirms pairing / bonding"
	default y
	help
	  Press Button 1 on the DK to accept Numeric Comparison, passkey, or
	  Just Works pairing (same as the ``pairing confirm`` shell command).
	  Button 4 still clears all bonds.

endmenu

menu "Zephyr Kernel"
source "Kconfig.zephyr"
endmenu
```

## prj.conf
```kconfig
#
# Copyright (c) 2020 Nordic Semiconductor ASA
#
# SPDX-License-Identifier: LicenseRef-Nordic-5-Clause
#
CONFIG_NCS_SAMPLES_DEFAULTS=y

CONFIG_DK_LIBRARY=y

CONFIG_NFC_T4T_NRFXLIB=y

CONFIG_NFC_NDEF=y
CONFIG_NFC_NDEF_MSG=y
CONFIG_NFC_NDEF_RECORD=y
CONFIG_NFC_NDEF_LE_OOB_REC=y
CONFIG_NFC_NDEF_CH_MSG=y

CONFIG_NFC_NDEF_TNEP_RECORD=y
CONFIG_NFC_TNEP_TAG=y
CONFIG_NFC_NDEF_PARSER=y
CONFIG_NFC_NDEF_CH_PARSER=y
CONFIG_NFC_NDEF_LE_OOB_REC_PARSER=y
CONFIG_NFC_TNEP_CH=y

CONFIG_BT=y
CONFIG_BT_SMP=y
CONFIG_BT_SMP_APP_PAIRING_ACCEPT=y
CONFIG_BT_SMP_ENFORCE_MITM=n

CONFIG_SHELL=y
CONFIG_SHELL_BACKEND_SERIAL=y

# Keep support for legacy pairing to retain compatibility
# with older Andorid phones that may not support OOB SC pairing
CONFIG_BT_SMP_SC_PAIR_ONLY=n
CONFIG_BT_PERIPHERAL=y
CONFIG_BT_DEVICE_NAME="Nordic_NFC_pairing"

CONFIG_BT_DIS=y
CONFIG_BT_DIS_MANUF_NAME=y
CONFIG_BT_DIS_MANUF_NAME_STR="NordicSemiconductor"
CONFIG_BT_DIS_PNP=y
CONFIG_BT_DIS_PNP_VID_SRC=2
CONFIG_BT_DIS_PNP_VID=0x1915
CONFIG_BT_DIS_PNP_PID=0xEEEB
CONFIG_BT_DIS_PNP_VER=0x0100

CONFIG_SYSTEM_WORKQUEUE_STACK_SIZE=2048
CONFIG_MAIN_STACK_SIZE=3072

CONFIG_BT_SETTINGS=y
CONFIG_FLASH=y
CONFIG_FLASH_PAGE_LAYOUT=y
CONFIG_FLASH_MAP=y

CONFIG_DK_LIBRARY=y

CONFIG_POLL=y

# NFC for OOB data only; advertise at boot; confirm pairing on DK Button 1
CONFIG_PERIPH_NFC_PAIRING_ADV_ON_BOOT=y
CONFIG_PERIPH_NFC_PAIRING_ADV_ON_NFC=n
CONFIG_PERIPH_NFC_PAIRING_ADV_ON_TNEP_OOB=n
CONFIG_PERIPH_NFC_PAIRING_DK_BUTTON_CONFIRM=y
```

## src/main.c
```c
/*
 * Copyright (c) 2020 Nordic Semiconductor ASA
 *
 * SPDX-License-Identifier: LicenseRef-Nordic-5-Clause
 */
#include <zephyr/kernel.h>

#include <zephyr/bluetooth/bluetooth.h>
#include <zephyr/bluetooth/hci.h>
#include <zephyr/bluetooth/conn.h>
#include <zephyr/bluetooth/uuid.h>
#include <zephyr/bluetooth/gatt.h>

#include <dk_buttons_and_leds.h>

#include <nfc_t4t_lib.h>
#include <nfc/t4t/ndef_file.h>

#include <nfc/ndef/msg.h>
#include <nfc/ndef/ch.h>
#include <nfc/ndef/ch_msg.h>
#include <nfc/ndef/le_oob_rec.h>
#include <nfc/ndef/le_oob_rec_parser.h>

#include <nfc/tnep/tag.h>
#include <nfc/tnep/ch.h>

#include <zephyr/settings/settings.h>

/* Runtime SMP pairing method selection; see pairing_mode.h / pairing_mode.c */
#include "pairing_mode.h"

#define DEVICE_NAME CONFIG_BT_DEVICE_NAME
#define DEVICE_NAME_LEN (sizeof(DEVICE_NAME) - 1)

#define K_POOL_EVENTS_CNT (NFC_TNEP_EVENTS_NUMBER + 1)

#define NDEF_MSG_BUF_SIZE 256

#define NFC_FIELD_LED DK_LED2
#define CON_STATUS_LED DK_LED1

#define KEY_PAIRING_CONFIRM_MASK DK_BTN1_MSK
#define KEY_BOND_REMOVE_MASK DK_BTN4_MSK

#define NFC_NDEF_LE_OOB_REC_PARSER_BUFF_SIZE 150
#define NFC_TNEP_BUFFER_SIZE 1024

static struct bt_le_oob oob_local;
static struct k_work adv_work;
static uint8_t conn_cnt;
static uint8_t tk_value[NFC_NDEF_LE_OOB_REC_TK_LEN];
static uint8_t remote_tk_value[NFC_NDEF_LE_OOB_REC_TK_LEN];
static struct bt_le_oob oob_remote;
static bool remote_sc_oob_ready;

/* Bonded address queue. */
K_MSGQ_DEFINE(bonds_queue,
	      sizeof(bt_addr_le_t),
	      CONFIG_BT_MAX_PAIRED,
	      4);

static const struct bt_data ad[] = {
	BT_DATA(BT_DATA_NAME_COMPLETE, DEVICE_NAME, DEVICE_NAME_LEN),
	BT_DATA_BYTES(BT_DATA_FLAGS, (BT_LE_AD_GENERAL | BT_LE_AD_NO_BREDR)),
};

static struct k_poll_signal pair_signal;
static struct k_poll_event events[K_POOL_EVENTS_CNT];
static uint8_t tnep_buffer[NFC_TNEP_BUFFER_SIZE];
static uint8_t tnep_swap_buffer[NFC_TNEP_BUFFER_SIZE];
static bool use_remote_tk;
#if defined(CONFIG_PERIPH_NFC_PAIRING_ADV_ON_NFC)
static bool adv_permission;
#endif

static int tk_value_generate(void)
{
	int err;

	err = bt_rand(tk_value, sizeof(tk_value));
	if (err) {
		printk("Random TK value generation failed: %d\n", err);
	}

	return err;
}

static void pair_key_generate_init(void)
{
	k_poll_signal_init(&pair_signal);
	k_poll_event_init(&events[NFC_TNEP_EVENTS_NUMBER],
			  K_POLL_TYPE_SIGNAL, K_POLL_MODE_NOTIFY_ONLY,
			  &pair_signal);
}

static int paring_key_generate(void)
{
	int err;

	printk("Generating new pairing keys\n");

	err = bt_le_oob_get_local(BT_ID_DEFAULT, &oob_local);
	if (err) {
		printk("Error while fetching local OOB data: %d\n", err);
	}

	return tk_value_generate();
}

static void paring_key_process(void)
{
	int err;

	if (events[NFC_TNEP_EVENTS_NUMBER].state == K_POLL_STATE_SIGNALED) {
		err = paring_key_generate();
		if (err) {
			printk("Pairing key generation error: %d\n", err);
		}

		k_poll_signal_reset(events[NFC_TNEP_EVENTS_NUMBER].signal);
		events[NFC_TNEP_EVENTS_NUMBER].state = K_POLL_STATE_NOT_READY;
	}
}

static void bond_find(const struct bt_bond_info *info, void *user_data)
{
	int err;
	struct bt_conn *conn;

	/* Filter already connected peers. */
	conn = bt_conn_lookup_addr_le(BT_ID_DEFAULT, &info->addr);
	if (conn) {
		bt_conn_unref(conn);
		return;
	}

	err = k_msgq_put(&bonds_queue, (void *) &info->addr, K_NO_WAIT);
	if (err) {
		printk("No space in the queue for the bond\n");
	}
}

static void advertising_start(void)
{
	k_msgq_purge(&bonds_queue);
	bt_foreach_bond(BT_ID_DEFAULT, bond_find, NULL);

	k_work_submit(&adv_work);
}

/**
 * @brief Callback function for handling NFC events.
 */
static void nfc_callback(void *context,
			 nfc_t4t_event_t event,
			 const uint8_t *data,
			 size_t data_length,
			 uint32_t flags)
{
	ARG_UNUSED(context);
	ARG_UNUSED(data);
	ARG_UNUSED(flags);

	switch (event) {
	case NFC_T4T_EVENT_FIELD_ON:
		nfc_tnep_tag_on_selected();
		dk_set_led_on(NFC_FIELD_LED);
#if defined(CONFIG_PERIPH_NFC_PAIRING_ADV_ON_NFC)
		adv_permission = true;
#endif
		break;

	case NFC_T4T_EVENT_FIELD_OFF:
		nfc_tnep_tag_on_selected();
		dk_set_led_off(NFC_FIELD_LED);
		break;

	case NFC_T4T_EVENT_NDEF_READ:
#if defined(CONFIG_PERIPH_NFC_PAIRING_ADV_ON_NFC)
		if (adv_permission) {
			advertising_start();
			adv_permission = false;
		}
#endif
		break;

	case NFC_T4T_EVENT_NDEF_UPDATED:
		if (data_length > 0) {
			nfc_tnep_tag_rx_msg_indicate(nfc_t4t_ndef_file_msg_get(data),
						     data_length);
		}

	default:
		break;
	}
}

static void advertising_continue(void)
{
	struct bt_le_adv_param adv_param;

	bt_addr_le_t addr;

	if (!k_msgq_get(&bonds_queue, &addr, K_NO_WAIT)) {
		char addr_buf[BT_ADDR_LE_STR_LEN];

		adv_param = *BT_LE_ADV_CONN_DIR(&addr);
		adv_param.options |= BT_LE_ADV_OPT_DIR_ADDR_RPA;

		int err = bt_le_adv_start(&adv_param, NULL, 0, NULL, 0);

		if (err) {
			printk("Directed advertising failed to start\n");
			return;
		}

		bt_addr_le_to_str(&addr, addr_buf, BT_ADDR_LE_STR_LEN);
		printk("Direct advertising to %s started\n", addr_buf);
	} else {
		int err;

		adv_param = *BT_LE_ADV_CONN_FAST_2;
		err = bt_le_adv_start(&adv_param, ad, ARRAY_SIZE(ad),
				      NULL, 0);

		/* Re-enabling advertising when it is already active
		 * is not an error here.
		 */
		if (err && (err != -EALREADY)) {
			printk("Advertising failed to start (err %d)\n", err);
			return;
		}

		printk("Regular advertising started\n");
	}
}

static void adv_handler(struct k_work *work)
{
	advertising_continue();
}

static bool remote_sc_oob_ready_fn(void)
{
	return remote_sc_oob_ready;
}

static bool remote_sc_oob_matches(struct bt_conn *conn)
{
	struct bt_conn_info info;

	if (!remote_sc_oob_ready) {
		return false;
	}

	if (bt_conn_get_info(conn, &info) != 0) {
		return false;
	}

	return bt_addr_le_cmp(info.le.remote, &oob_remote.addr) == 0;
}

static void lesc_oob_data_set(struct bt_conn *conn,
			      struct bt_conn_oob_info *oob_info)
{
	int err;
	char addr[BT_ADDR_LE_STR_LEN];
	struct bt_conn_info info;

	err = bt_conn_get_info(conn, &info);
	if (err) {
		return;
	}

	struct bt_le_oob_sc_data *oob_data_local =
		oob_info->lesc.oob_config != BT_CONN_OOB_REMOTE_ONLY
					  ? &oob_local.le_sc_data
					  : NULL;
	struct bt_le_oob_sc_data *oob_data_remote =
		oob_info->lesc.oob_config != BT_CONN_OOB_LOCAL_ONLY
					  ? &oob_remote.le_sc_data
					  : NULL;

	if (oob_data_remote && !remote_sc_oob_matches(conn)) {
		bt_addr_le_to_str(info.le.remote, addr, sizeof(addr));
		printk("No remote LE SC OOB for %s (use TNEP handover or clear peer OOB)\n",
		       addr);
		oob_data_remote = NULL;
	}

	if (oob_data_local &&
	    bt_addr_le_cmp(info.le.local, &oob_local.addr)) {
		bt_addr_le_to_str(info.le.local, addr, sizeof(addr));
		printk("No local OOB data for %s\n", addr);
		bt_conn_auth_cancel(conn);
		return;
	}

	printk("LESC OOB: config %d, local %s, remote %s\n", oob_info->lesc.oob_config,
	       oob_data_local ? "yes" : "no", oob_data_remote ? "yes" : "no");

	err = bt_le_oob_set_sc_data(conn, oob_data_local, oob_data_remote);
	if (err) {
		printk("bt_le_oob_set_sc_data failed: %d\n", err);
		bt_conn_auth_cancel(conn);
	}
}

static void remote_sc_oob_clear(void)
{
	remote_sc_oob_ready = false;
	memset(&oob_remote, 0, sizeof(oob_remote));
}

static void legacy_tk_value_set(struct bt_conn *conn)
{
	int err;
	const uint8_t *tk = use_remote_tk ? remote_tk_value : tk_value;

	err = bt_le_oob_set_legacy_tk(conn, tk);
	if (err) {
		printk("TK value set error: %d\n", err);
	}

	use_remote_tk = false;
}

static void pairing_complete(struct bt_conn *conn, bool bonded)
{
	char addr[BT_ADDR_LE_STR_LEN];

	bt_addr_le_to_str(bt_conn_get_dst(conn), addr, sizeof(addr));

	printk("Pairing completed: %s, bonded: %d\n", addr, bonded);

	k_poll_signal_raise(&pair_signal, 0);
	remote_sc_oob_clear();
	/* Restore OOB flags for the configured mode (do not leave flags cleared). */
	pairing_mode_apply();
}

static void pairing_failed(struct bt_conn *conn, enum bt_security_err reason)
{
	char addr[BT_ADDR_LE_STR_LEN];

	bt_addr_le_to_str(bt_conn_get_dst(conn), addr, sizeof(addr));

	printk("Pairing failed conn: %s, reason %d %s\n", addr, reason,
	       bt_security_err_to_str(reason));

	k_poll_signal_raise(&pair_signal, 0);
	remote_sc_oob_clear();
	pairing_mode_apply();
}

static struct bt_conn_auth_info_cb conn_auth_info_callbacks = {
	.pairing_complete = pairing_complete,
	.pairing_failed = pairing_failed
};

static void connected(struct bt_conn *conn, uint8_t err)
{
	char addr[BT_ADDR_LE_STR_LEN];

	bt_addr_le_to_str(bt_conn_get_dst(conn), addr, sizeof(addr));

	if (err) {
		if (err == BT_HCI_ERR_ADV_TIMEOUT) {
			printk("Direct advertising to %s timed out\n", addr);
			k_work_submit(&adv_work);
		} else {
			printk("Failed to connect to %s 0x%02x %s\n", addr, err,
			       bt_hci_err_to_str(err));
		}

		return;
	}

	conn_cnt++;

	printk("Connected %s\n", addr);
	dk_set_led_on(CON_STATUS_LED);

	if (conn_cnt < CONFIG_BT_MAX_CONN) {
		advertising_start();
	}
}

static void disconnected(struct bt_conn *conn, uint8_t reason)
{
	char addr[BT_ADDR_LE_STR_LEN];

	bt_addr_le_to_str(bt_conn_get_dst(conn), addr, sizeof(addr));

	conn_cnt--;

	if (!conn_cnt) {
		dk_set_led_off(CON_STATUS_LED);
	}

	printk("Disconnected from %s, reason 0x%02x %s\n", addr, reason, bt_hci_err_to_str(reason));
	advertising_start();
}

static void security_changed(struct bt_conn *conn, bt_security_t level, enum bt_security_err err)
{
	char addr[BT_ADDR_LE_STR_LEN];

	bt_addr_le_to_str(bt_conn_get_dst(conn), addr, sizeof(addr));

	if (!err) {
		printk("Security changed: %s level %u\n", addr, level);
	} else {
		printk("Security failed: %s level %u err %d %s\n", addr, level, err,
		       bt_security_err_to_str(err));
	}
}

BT_CONN_CB_DEFINE(conn_callbacks) = {
	.connected = connected,
	.disconnected = disconnected,
	.security_changed = security_changed,
};


/** .. include_startingpoint_pair_msg_rst */
static int tnep_initial_msg_encode(struct nfc_ndef_msg_desc *msg)
{
	int err;
	struct nfc_ndef_ch_msg_records ch_records;
	static struct nfc_ndef_le_oob_rec_payload_desc rec_payload;

	NFC_NDEF_LE_OOB_RECORD_DESC_DEF(oob_rec, '0', &rec_payload);
	NFC_NDEF_CH_AC_RECORD_DESC_DEF(oob_ac, NFC_AC_CPS_ACTIVE, 1, "0", 0);
	NFC_NDEF_CH_HS_RECORD_DESC_DEF(hs_rec, NFC_NDEF_CH_MSG_MAJOR_VER,
				       NFC_NDEF_CH_MSG_MINOR_VER, 1);

	memset(&rec_payload, 0, sizeof(rec_payload));

	rec_payload.addr = &oob_local.addr;
	rec_payload.local_name = bt_get_name();
	rec_payload.le_role = NFC_NDEF_LE_OOB_REC_LE_ROLE(
		NFC_NDEF_LE_OOB_REC_LE_ROLE_PERIPH_ONLY);
	rec_payload.appearance = NFC_NDEF_LE_OOB_REC_APPEARANCE(
		CONFIG_BT_DEVICE_APPEARANCE);
	rec_payload.flags = NFC_NDEF_LE_OOB_REC_FLAGS(BT_LE_AD_NO_BREDR);
	pairing_mode_fill_oob_rec(&rec_payload, &oob_local.le_sc_data, tk_value);

	ch_records.ac = &NFC_NDEF_CH_AC_RECORD_DESC(oob_ac);
	ch_records.carrier = &NFC_NDEF_LE_OOB_RECORD_DESC(oob_rec);
	ch_records.cnt = 1;

	err =  nfc_ndef_ch_msg_hs_create(msg,
					 &NFC_NDEF_CH_RECORD_DESC(hs_rec),
					 &ch_records);
	if (err) {
		return err;
	}

	return nfc_tnep_initial_msg_encode(msg, NULL, 0);
}
/** .. include_endpoint_pair_msg_rst */

static int check_oob_carrier(const struct nfc_tnep_ch_record *ch_record,
			     const struct nfc_ndef_record_desc **oob_data)
{
	const struct nfc_ndef_ch_ac_rec *ac_rec = NULL;

	for (size_t i = 0; i < ch_record->count; i++) {
		if (nfc_ndef_le_oob_rec_check(ch_record->carrier[i])) {
			*oob_data = ch_record->carrier[i];
		}
	}

	if (!oob_data) {
		printk("Connection Handover Requester not supporting OOB BLE\n");
		return -EINVAL;
	}

	/* Look for the corresponding Alternative Carrier Record. */
	for (size_t i = 0; i < ch_record->count; i++) {
		if (((*oob_data)->id_length == ch_record->ac[i].carrier_data_ref.length) &&
		    (memcmp((*oob_data)->id,
			    ch_record->ac[i].carrier_data_ref.data,
			    (*oob_data)->id_length) == 0)) {
			ac_rec = &ch_record->ac[i];
		}
	}

	if (!ac_rec) {
		printk("No Alternative Carrier Record for OOB LE carrier\n");
		return -EINVAL;
	}

	/* Check carrier state */
	if ((ac_rec->cps != NFC_AC_CPS_ACTIVE) &&
	    (ac_rec->cps != NFC_AC_CPS_ACTIVATING)) {
		printk("LE OBB Carrier inactive\n");
		return -EINVAL;
	}

	return 0;
}

static int oob_le_data_handle(const struct nfc_ndef_record_desc *rec,
			      bool request)
{
	int err;
	const struct nfc_ndef_le_oob_rec_payload_desc *oob;
	uint8_t desc_buf[NFC_NDEF_LE_OOB_REC_PARSER_BUFF_SIZE];
	uint32_t desc_buf_len = sizeof(desc_buf);

	err = nfc_ndef_le_oob_rec_parse(rec, desc_buf,
					&desc_buf_len);
	if (err) {
		printk("Error during NDEF LE OOB Record parsing, err: %d.\n",
			err);
	}

	oob = (struct nfc_ndef_le_oob_rec_payload_desc *) desc_buf;

	nfc_ndef_le_oob_rec_printout(oob);

	if ((*oob->le_role != NFC_NDEF_LE_OOB_REC_LE_ROLE_CENTRAL_ONLY) &&
	    (*oob->le_role != NFC_NDEF_LE_OOB_REC_LE_ROLE_CENTRAL_PREFFERED)) {
		printk("Unsupported Device LE Role\n");
		return -EINVAL;
	}

	/* Only merge poller OOB into SMP when mode is lesc_oob / legacy_oob. */
	if (pairing_mode_accepts_remote_oob()) {
		if (oob->le_sc_data) {
			oob_remote.le_sc_data = *oob->le_sc_data;
			bt_addr_le_copy(&oob_remote.addr, oob->addr);
			remote_sc_oob_ready = true;
			pairing_mode_apply();
			printk("Remote LE SC OOB stored; SMP mutual OOB enabled\n");
		}

		if (oob->tk_value) {
			bt_le_oob_set_legacy_flag(true);
			memcpy(remote_tk_value, oob->tk_value, sizeof(remote_tk_value));
			use_remote_tk = request;
		}
	}

#if defined(CONFIG_PERIPH_NFC_PAIRING_ADV_ON_TNEP_OOB)
	advertising_start();
#endif

	return 0;
}

/** .. include_startingpoint_nfc_tnep_ch_tag_rst */
static int carrier_prepare(void)
{
	static struct nfc_ndef_le_oob_rec_payload_desc rec_payload;

	NFC_NDEF_LE_OOB_RECORD_DESC_DEF(oob_rec, '0', &rec_payload);
	NFC_NDEF_CH_AC_RECORD_DESC_DEF(oob_ac, NFC_AC_CPS_ACTIVE, 1, "0", 0);

	memset(&rec_payload, 0, sizeof(rec_payload));

	rec_payload.addr = &oob_local.addr;
	rec_payload.local_name = bt_get_name();
	rec_payload.le_role = NFC_NDEF_LE_OOB_REC_LE_ROLE(
		NFC_NDEF_LE_OOB_REC_LE_ROLE_PERIPH_ONLY);
	rec_payload.appearance = NFC_NDEF_LE_OOB_REC_APPEARANCE(
		CONFIG_BT_DEVICE_APPEARANCE);
	rec_payload.flags = NFC_NDEF_LE_OOB_REC_FLAGS(BT_LE_AD_NO_BREDR);
	pairing_mode_fill_oob_rec(&rec_payload, &oob_local.le_sc_data, tk_value);

	return nfc_tnep_ch_carrier_set(&NFC_NDEF_CH_AC_RECORD_DESC(oob_ac),
				       &NFC_NDEF_LE_OOB_RECORD_DESC(oob_rec),
				       1);
}

#if defined(CONFIG_NFC_TAG_CH_REQUESTER)
static int tnep_ch_request_prepare(void)
{
#if defined(CONFIG_PERIPH_NFC_PAIRING_ADV_ON_NFC) || \
	defined(CONFIG_PERIPH_NFC_PAIRING_ADV_ON_TNEP_OOB)
	bt_le_adv_stop();
#endif
	return carrier_prepare();
}

static int tnep_ch_select_received(const struct nfc_tnep_ch_record *ch_select,
				   bool inactive)
{
	int err;
	const struct nfc_ndef_record_desc *oob_data = NULL;

	if (!ch_select->count) {
		return -EINVAL;
	}

	/* All alternative carrier are inactive */
	if (inactive) {
		/* Try send request again. */
		return carrier_prepare();
	}

	err = check_oob_carrier(ch_select, &oob_data);
	if (err) {
		return err;
	}

	err = oob_le_data_handle(oob_data, false);
	if (err) {
		return err;
	}

	return 0;

}
#endif /* defined(CONFIG_NFC_TAG_CH_REQUESTER) */

static int tnep_ch_request_received(const struct nfc_tnep_ch_request *ch_req)
{
	int err;
	const struct nfc_ndef_record_desc *oob_data = NULL;

	if (!ch_req->ch_record.count) {
		return -EINVAL;
	}

	err = check_oob_carrier(&ch_req->ch_record, &oob_data);
	if (err) {
		return err;
	}

#if defined(CONFIG_PERIPH_NFC_PAIRING_ADV_ON_NFC) || \
	defined(CONFIG_PERIPH_NFC_PAIRING_ADV_ON_TNEP_OOB)
	bt_le_adv_stop();
#endif

	err = oob_le_data_handle(oob_data, true);
	if (err) {
		return err;
	}

	return carrier_prepare();
}

static struct nfc_tnep_ch_cb ch_cb = {
#if defined(CONFIG_NFC_TAG_CH_REQUESTER)
	.request_msg_prepare = tnep_ch_request_prepare,
	.select_msg_recv = tnep_ch_select_received,
#endif
	.request_msg_recv = tnep_ch_request_received
};
/** .. include_endpoint_nfc_tnep_ch_tag_rst */

static void nfc_init(void)
{
	int err;

	/* TNEP init */
	err = nfc_tnep_tag_tx_msg_buffer_register(tnep_buffer, tnep_swap_buffer,
						  sizeof(tnep_buffer));
	if (err) {
		printk("Cannot register tnep buffer, err: %d\n", err);
		return;
	}

	err = nfc_tnep_tag_init(events, NFC_TNEP_EVENTS_NUMBER,
				nfc_t4t_ndef_rwpayload_set);
	if (err) {
		printk("Cannot initialize TNEP protocol, err: %d\n", err);
		return;
	}

	/* Set up NFC */
	err = nfc_t4t_setup(nfc_callback, NULL);
	if (err) {
		printk("Cannot setup NFC T4T library!\n");
		return;
	}

	err = nfc_tnep_tag_initial_msg_create(2, tnep_initial_msg_encode);
	if (err) {
		printk("Cannot create initial TNEP message, err: %d\n", err);
	}

	err = nfc_tnep_ch_service_init(&ch_cb);
	if (err) {
		printk("TNEP CH Service init error: %d\n", err);
		return;
	}

	/* Start sensing NFC field */
	err = nfc_t4t_emulation_start();
	if (err) {
		printk("Cannot start emulation!\n");
		return;
	}

	printk("NFC configuration done\n");
}

/* Called from pairing_mode_set() to align NFC NDEF with the active pairing mode. */
int pairing_mode_nfc_refresh(void)
{
	int err;

	err = paring_key_generate();
	if (err) {
		return err;
	}

	return nfc_tnep_tag_initial_msg_create(2, tnep_initial_msg_encode);
}

void button_changed(uint32_t button_state, uint32_t has_changed)
{
	int err;
	uint32_t buttons = button_state & has_changed;

#if defined(CONFIG_PERIPH_NFC_PAIRING_DK_BUTTON_CONFIRM)
	if (buttons & KEY_PAIRING_CONFIRM_MASK) {
		err = pairing_mode_user_confirm();
		if (err == -ENOENT) {
			printk("Button 1: no pairing awaiting confirm\n");
		} else if (err) {
			printk("Button 1: pairing confirm failed (%d)\n", err);
		} else {
			printk("Button 1: pairing confirmed\n");
		}
	}
#endif

	if (buttons & KEY_BOND_REMOVE_MASK) {
		err = bt_unpair(BT_ID_DEFAULT, NULL);
		if (err) {
			printk("Bond remove failed err: %d\n", err);
		} else {
			printk("All bond removed\n");
		}
	}
}

int main(void)
{
	int err;

	printk("Starting Bluetooth NFC Pairing Reference sample\n");

	/* Configure LED-pins as outputs */
	err = dk_leds_init();
	if (err) {
		printk("Cannot init LEDs!\n");
		return 0;
	}

	/* Configure buttons */
	err = dk_buttons_init(button_changed);
	if (err) {
		printk("Cannot init buttons (err %d\n", err);
	}

	err = bt_conn_auth_info_cb_register(&conn_auth_info_callbacks);
	if (err) {
		printk("Failed to register authorization info callbacks.\n");
		return 0;
	}

	err = bt_enable(NULL);
	if (err) {
		printk("Bluetooth init failed (err %d)\n", err);
		return 0;
	}

	printk("Bluetooth initialized\n");

	if (IS_ENABLED(CONFIG_SETTINGS)) {
		settings_load();
	}

	err = paring_key_generate();
	if (err) {
		return 0;
	}

	/* OOB secrets for auth_oob_data_request; default mode is lesc_oob. */
	err = pairing_mode_init(&(struct pairing_mode_oob_ops){
		.lesc_oob_set = lesc_oob_data_set,
		.legacy_tk_set = legacy_tk_value_set,
		.remote_sc_oob_matches = remote_sc_oob_matches,
		.remote_sc_oob_ready = remote_sc_oob_ready_fn,
	});
	if (err) {
		printk("Pairing mode init failed (err %d)\n", err);
		return 0;
	}

#if defined(CONFIG_SHELL)
	pairing_mode_shell_init();
	printk("Pairing shell: 'pairing list', 'pairing set <mode>', 'pairing show'\n");
#endif

	k_work_init(&adv_work, adv_handler);
	pair_key_generate_init();
	nfc_init();

	(void)pairing_mode_nfc_refresh();

#if defined(CONFIG_PERIPH_NFC_PAIRING_ADV_ON_BOOT)
	advertising_start();
	printk("Connectable advertising started (not triggered by NFC)\n");
#endif

#if defined(CONFIG_PERIPH_NFC_PAIRING_DK_BUTTON_CONFIRM)
	printk("Press Button 1 to confirm pairing when prompted\n");
#endif

	for (;;) {
		k_poll(events, ARRAY_SIZE(events), K_FOREVER);
		nfc_tnep_tag_process();
		paring_key_process();
	}
}
```

## src/pairing_mode.c
```c
/*
 * Copyright (c) 2026 Nordic Semiconductor ASA
 *
 * SPDX-License-Identifier: LicenseRef-Nordic-5-Clause
 */

/**
 * @file pairing_mode.c
 * @brief Implementation of runtime SMP pairing method selection.
 *
 * Mode → mechanism mapping
 * ------------------------
 * | Mode (shell name)   | SMP pairing method      | auth_cb used   | OOB flags |
 * |---------------------|-------------------------|----------------|-----------|
 * | lesc_jw             | LE SC Just Works        | auth_cb_none   | off       |
 * | lesc_oob            | LE SC OOB               | auth_cb_oob    | SC on     |
 * | legacy_jw           | Legacy Just Works       | auth_cb_none   | off       |
 * | legacy_oob          | Legacy OOB              | auth_cb_oob    | legacy on |
 * | lesc_numeric        | LE SC Numeric Comparison| auth_cb_yesno  | off       |
 * | lesc_pk_display     | LE SC Passkey (display) | auth_cb_display| off       |
 * | lesc_pk_input       | LE SC Passkey (entry)   | auth_cb_input  | off       |
 *
 * pairing_accept() adds policy: e.g. lesc_jw rejects a peer that advertises OOB
 * or Legacy-only, so we do not fall back to a different method than selected.
 *
 * Pairing flow (typical)
 * ----------------------
 * 1. pairing_mode_set() / shell "pairing set" → register auth_cb, apply flags,
 *    refresh NFC NDEF (main.c).
 * 2. Peer connects; SMP Pairing Request received.
 * 3. pairing_accept() checks peer io_capability, oob_data_flag, auth_req.
 * 4. Host builds Pairing Response (IO from auth_cb, OOB from bt_le_oob_set_*).
 * 5. Stack picks method (Just Works / OOB / passkey / numeric) from both sides.
 * 6. For OOB/passkey/numeric, auth callbacks run; shell confirm/passkey completes.
 * 7. pairing_complete in main.c → pairing_mode_apply() restores configured flags.
 */

#include "pairing_mode.h"

#include <errno.h>
#include <string.h>

#include <zephyr/kernel.h>
#include <zephyr/shell/shell.h>

#include <zephyr/bluetooth/conn.h>

/** AuthReq LE Secure Connections bit in Pairing Request/Response (Core Spec H). */
#define AUTH_SC_FLAG 0x08

/* Connection that is waiting for shell pairing confirm / passkey. */

static const struct pairing_mode_oob_ops *oob_ops;
static enum pairing_mode_id current_mode = PAIRING_MODE_LESC_OOB;
static struct bt_conn *pairing_conn;
static int (*nfc_refresh_fn)(void);

static void pairing_conn_set(struct bt_conn *conn)
{
	if (pairing_conn) {
		bt_conn_unref(pairing_conn);
		pairing_conn = NULL;
	}

	if (conn) {
		pairing_conn = bt_conn_ref(conn);
	}
}

static void auth_cancel(struct bt_conn *conn)
{
	char addr[BT_ADDR_LE_STR_LEN];

	bt_addr_le_to_str(bt_conn_get_dst(conn), addr, sizeof(addr));
	printk("Pairing cancelled: %s\n", addr);
	pairing_conn_set(NULL);
}

static void auth_addr_print(struct bt_conn *conn, char *addr, size_t len)
{
	bt_addr_le_to_str(bt_conn_get_dst(conn), addr, len);
}

static void auth_passkey_display(struct bt_conn *conn, unsigned int passkey)
{
	char passkey_str[7];
	char addr[BT_ADDR_LE_STR_LEN];

	snprintk(passkey_str, sizeof(passkey_str), "%06u", passkey);
	auth_addr_print(conn, addr, sizeof(addr));
	printk("Passkey for %s: %s (use: pairing confirm)\n", addr, passkey_str);
	pairing_conn_set(conn);
}

static void auth_passkey_confirm(struct bt_conn *conn, unsigned int passkey)
{
	char passkey_str[7];
	char addr[BT_ADDR_LE_STR_LEN];

	snprintk(passkey_str, sizeof(passkey_str), "%06u", passkey);
	auth_addr_print(conn, addr, sizeof(addr));
	printk("Confirm passkey for %s: %s (use: pairing confirm)\n", addr, passkey_str);
	pairing_conn_set(conn);
}

static void auth_passkey_entry(struct bt_conn *conn)
{
	printk("Enter passkey (use: pairing passkey <000000-999999>)\n");
	pairing_conn_set(conn);
}

static void auth_pairing_confirm(struct bt_conn *conn)
{
	printk("Confirm Just Works pairing (use: pairing confirm)\n");
	pairing_conn_set(conn);
}

/*
 * Invoked by the SMP stack when the negotiated method needs OOB data.
 * Only lesc_oob / legacy_oob modes register oob_data_request; other modes
 * cancel here if the peer somehow triggered OOB anyway.
 */
static void auth_oob_data_request(struct bt_conn *conn, struct bt_conn_oob_info *info)
{
	if (!oob_ops) {
		bt_conn_auth_cancel(conn);
		return;
	}

	switch (current_mode) {
	case PAIRING_MODE_LESC_OOB:
		if (info->type == BT_CONN_OOB_LE_SC && oob_ops->lesc_oob_set) {
			printk("LESC OOB data requested\n");
			oob_ops->lesc_oob_set(conn, info);
		} else {
			bt_conn_auth_cancel(conn);
		}
		break;
	case PAIRING_MODE_LEGACY_OOB:
		if (info->type == BT_CONN_OOB_LE_LEGACY && oob_ops->legacy_tk_set) {
			printk("Legacy TK value requested\n");
			oob_ops->legacy_tk_set(conn);
		} else {
			bt_conn_auth_cancel(conn);
		}
		break;
	default:
		bt_conn_auth_cancel(conn);
		break;
	}
}

/*
 * Called for each incoming Pairing Request before we send Pairing Response.
 * Filters peer features so the negotiated method stays within the selected mode.
 * Does not override IO capability (that comes from the registered auth_cb).
 */
static enum bt_security_err pairing_accept(struct bt_conn *conn,
					   const struct bt_conn_pairing_feat *const feat)
{
	bool peer_sc = feat->auth_req & AUTH_SC_FLAG;
	bool peer_oob = feat->oob_data_flag;

	ARG_UNUSED(conn);

	switch (current_mode) {
	case PAIRING_MODE_LESC_JUST_WORKS:
		if (!peer_sc) {
			return BT_SECURITY_ERR_AUTH_REQUIREMENT;
		}
		if (peer_oob) {
			return BT_SECURITY_ERR_AUTH_REQUIREMENT;
		}
		break;
	case PAIRING_MODE_LESC_OOB:
		if (!peer_sc) {
			return BT_SECURITY_ERR_AUTH_REQUIREMENT;
		}
		/*
		 * Note: bt_le_oob_set_sc_flag() here is too late — Zephyr already
		 * copied sc_oobd_present into Pairing Response before pairing_accept().
		 * SMP OOB flag must be correct via pairing_mode_apply() before pairing.
		 */
		printk("lesc_oob: peer OOB flag %u (have remote SC OOB: %u)\n", peer_oob,
		       (oob_ops && oob_ops->remote_sc_oob_ready &&
			oob_ops->remote_sc_oob_ready()) ?
			       1U :
			       0U);
		break;
	case PAIRING_MODE_LEGACY_JUST_WORKS:
		if (peer_sc) {
			return BT_SECURITY_ERR_AUTH_REQUIREMENT;
		}
		if (peer_oob) {
			return BT_SECURITY_ERR_AUTH_REQUIREMENT;
		}
		break;
	case PAIRING_MODE_LEGACY_OOB:
		if (peer_sc) {
			return BT_SECURITY_ERR_AUTH_REQUIREMENT;
		}
		/* Peer may set OOB in Pairing Request; allow legacy TK exchange. */
		if (peer_oob) {
			bt_le_oob_set_legacy_flag(true);
		}
		break;
	case PAIRING_MODE_LESC_NUMERIC_COMP:
	case PAIRING_MODE_LESC_PASSKEY_INPUT:
	case PAIRING_MODE_LESC_PASSKEY_DISPLAY:
		if (!peer_sc) {
			return BT_SECURITY_ERR_AUTH_REQUIREMENT;
		}
		if (peer_oob) {
			return BT_SECURITY_ERR_AUTH_REQUIREMENT;
		}
		break;
	default:
		break;
	}

	return BT_SECURITY_ERR_SUCCESS;
}

/*
 * Auth callback sets — each non-NULL handler changes our advertised IO capability.
 * See auth_cb_for_mode() for which set is registered per pairing_mode_id.
 */
static struct bt_conn_auth_cb auth_cb_none = {
	.cancel = auth_cancel,
	.pairing_accept = pairing_accept,
	/* No passkey/OOB → BT_SMP_IO_NO_INPUT_OUTPUT → Just Works (if no OOB flag). */
};

static struct bt_conn_auth_cb auth_cb_oob = {
	.cancel = auth_cancel,
	.oob_data_request = auth_oob_data_request,
	.pairing_accept = pairing_accept,
	/* oob_data_request → main.c supplies SC or legacy TK. */
};

static struct bt_conn_auth_cb auth_cb_yesno = {
	.cancel = auth_cancel,
	.passkey_display = auth_passkey_display,
	.passkey_confirm = auth_passkey_confirm,
	.pairing_accept = pairing_accept,
	/* Display + confirm → BT_SMP_IO_DISPLAY_YESNO → Numeric Comparison. */
};

static struct bt_conn_auth_cb auth_cb_display = {
	.cancel = auth_cancel,
	.passkey_display = auth_passkey_display,
	.pairing_confirm = auth_pairing_confirm,
	.pairing_accept = pairing_accept,
	/* Display only → peripheral shows passkey; central enters it. */
};

static struct bt_conn_auth_cb auth_cb_input = {
	.cancel = auth_cancel,
	.passkey_entry = auth_passkey_entry,
	.pairing_confirm = auth_pairing_confirm,
	.pairing_accept = pairing_accept,
	/* Keyboard only → peripheral enters passkey via shell. */
};

/* Zephyr allows only one global auth_cb; unregister before registering another. */
static int auth_cb_register(const struct bt_conn_auth_cb *cb)
{
	int err;

	err = bt_conn_auth_cb_register(NULL);
	if (err) {
		return err;
	}

	return bt_conn_auth_cb_register(cb);
}

/** Pick auth_cb_* so Zephyr advertises the IO caps for the target SMP method. */
static const struct bt_conn_auth_cb *auth_cb_for_mode(enum pairing_mode_id mode)
{
	switch (mode) {
	case PAIRING_MODE_LESC_JUST_WORKS:
	case PAIRING_MODE_LEGACY_JUST_WORKS:
		return &auth_cb_none;
	case PAIRING_MODE_LESC_OOB:
	case PAIRING_MODE_LEGACY_OOB:
		return &auth_cb_oob;
	case PAIRING_MODE_LESC_NUMERIC_COMP:
		return &auth_cb_yesno;
	case PAIRING_MODE_LESC_PASSKEY_DISPLAY:
		return &auth_cb_display;
	case PAIRING_MODE_LESC_PASSKEY_INPUT:
		return &auth_cb_input;
	default:
		return NULL;
	}
}

/*
 * Updates global SMP OOB-present flags read when building Pairing Response
 * (see sc_oobd_present / legacy_oobd_present in smp.c).
 */
void pairing_mode_apply(void)
{
	if (current_mode == PAIRING_MODE_LESC_OOB) {
		/*
		 * SMP OOB bit in Pairing Response: set only when we have the central's
		 * SC OOB (TNEP). If false while the phone read our NFC tag, the phone
		 * still uses our NDEF OOB; SMP uses LOCAL_ONLY (we supply local SC OOB).
		 */
		const bool remote_ready = oob_ops && oob_ops->remote_sc_oob_ready &&
					  oob_ops->remote_sc_oob_ready();

		bt_le_oob_set_sc_flag(remote_ready);
		bt_le_oob_set_legacy_flag(false);
	} else {
		bt_le_oob_set_sc_flag(false);
		bt_le_oob_set_legacy_flag(pairing_mode_nfc_includes_legacy_oob());
	}
}

bool pairing_mode_nfc_includes_sc_oob(void)
{
	return current_mode == PAIRING_MODE_LESC_OOB;
}

bool pairing_mode_nfc_includes_legacy_oob(void)
{
	return current_mode == PAIRING_MODE_LEGACY_OOB;
}

bool pairing_mode_accepts_remote_oob(void)
{
	return current_mode == PAIRING_MODE_LESC_OOB ||
	       current_mode == PAIRING_MODE_LEGACY_OOB;
}

void pairing_mode_fill_oob_rec(struct nfc_ndef_le_oob_rec_payload_desc *rec,
			       struct bt_le_oob_sc_data *le_sc_data,
			       uint8_t *tk_value)
{
	rec->le_sc_data = pairing_mode_nfc_includes_sc_oob() ? le_sc_data : NULL;
	rec->tk_value = pairing_mode_nfc_includes_legacy_oob() ? tk_value : NULL;
}

enum pairing_mode_id pairing_mode_get(void)
{
	return current_mode;
}

int pairing_mode_set(enum pairing_mode_id mode, int (*nfc_refresh)(void))
{
	const struct bt_conn_auth_cb *cb;
	int err;

	if (mode >= PAIRING_MODE_COUNT) {
		return -EINVAL;
	}

	cb = auth_cb_for_mode(mode);
	if (!cb) {
		return -EINVAL;
	}

	err = auth_cb_register(cb);
	if (err) {
		return err;
	}

	current_mode = mode;
	nfc_refresh_fn = nfc_refresh;
	pairing_mode_apply();

	if (nfc_refresh_fn) {
		err = nfc_refresh_fn();
		if (err) {
			printk("NFC NDEF refresh failed: %d\n", err);
		}
	}

	printk("Pairing mode: %s\n", pairing_mode_name(mode));

	return 0;
}

static const char *const mode_names[] = {
	[PAIRING_MODE_LESC_JUST_WORKS] = "lesc_jw",
	[PAIRING_MODE_LESC_OOB] = "lesc_oob",
	[PAIRING_MODE_LEGACY_JUST_WORKS] = "legacy_jw",
	[PAIRING_MODE_LEGACY_OOB] = "legacy_oob",
	[PAIRING_MODE_LESC_NUMERIC_COMP] = "lesc_numeric",
	[PAIRING_MODE_LESC_PASSKEY_INPUT] = "lesc_pk_input",
	[PAIRING_MODE_LESC_PASSKEY_DISPLAY] = "lesc_pk_display",
};

const char *pairing_mode_name(enum pairing_mode_id mode)
{
	if (mode >= PAIRING_MODE_COUNT) {
		return "unknown";
	}

	return mode_names[mode];
}

int pairing_mode_init(const struct pairing_mode_oob_ops *ops)
{
	if (!ops || !ops->lesc_oob_set || !ops->legacy_tk_set ||
	    !ops->remote_sc_oob_matches || !ops->remote_sc_oob_ready) {
		return -EINVAL;
	}

	oob_ops = ops;

	return pairing_mode_set(PAIRING_MODE_LESC_OOB, NULL);
}

static int pairing_mode_from_name(const char *name, enum pairing_mode_id *mode)
{
	for (enum pairing_mode_id i = 0; i < PAIRING_MODE_COUNT; i++) {
		if (!strcmp(name, mode_names[i])) {
			*mode = i;
			return 0;
		}
	}

	return -EINVAL;
}

#if defined(CONFIG_SHELL)
/* Shell: pairing list | show | set <mode> | confirm | passkey <pin> */

static int cmd_pairing_list(const struct shell *sh, size_t argc, char **argv)
{
	ARG_UNUSED(argc);
	ARG_UNUSED(argv);

	for (enum pairing_mode_id i = 0; i < PAIRING_MODE_COUNT; i++) {
		shell_print(sh, "  %s", mode_names[i]);
	}

	return 0;
}

static int cmd_pairing_show(const struct shell *sh, size_t argc, char **argv)
{
	ARG_UNUSED(argc);
	ARG_UNUSED(argv);

	shell_print(sh, "%s", mode_names[current_mode]);
	return 0;
}

extern int pairing_mode_nfc_refresh(void);

static int cmd_pairing_set(const struct shell *sh, size_t argc, char **argv)
{
	enum pairing_mode_id mode;
	int err;

	if (argc != 2) {
		shell_error(sh, "Usage: pairing set <mode>");
		return -EINVAL;
	}

	err = pairing_mode_from_name(argv[1], &mode);
	if (err) {
		shell_error(sh, "Unknown mode '%s'. Use: pairing list", argv[1]);
		return err;
	}

	err = pairing_mode_set(mode, pairing_mode_nfc_refresh);
	if (err) {
		shell_error(sh, "Failed to set mode (%d)", err);
	}

	return err;
}

bool pairing_mode_confirm_pending(void)
{
	return pairing_conn != NULL;
}

int pairing_mode_user_confirm(void)
{
	int err;

	if (!pairing_conn) {
		return -ENOENT;
	}

	/* Numeric Comparison / passkey confirm path. */
	err = bt_conn_auth_passkey_confirm(pairing_conn);
	if (!err) {
		return 0;
	}

	/* Just Works confirmation path (if stack requested pairing_confirm). */
	return bt_conn_auth_pairing_confirm(pairing_conn);
}

static int cmd_pairing_confirm(const struct shell *sh, size_t argc, char **argv)
{
	int err;

	ARG_UNUSED(argc);
	ARG_UNUSED(argv);

	err = pairing_mode_user_confirm();
	if (err == -ENOENT) {
		shell_error(sh, "No pairing in progress");
	} else if (err) {
		shell_error(sh, "Confirm failed (%d)", err);
	}

	return err;
}

static int cmd_pairing_passkey(const struct shell *sh, size_t argc, char **argv)
{
	unsigned int passkey;
	int err;

	if (argc != 2) {
		shell_error(sh, "Usage: pairing passkey <000000-999999>");
		return -EINVAL;
	}

	if (!pairing_conn) {
		shell_error(sh, "No pairing in progress");
		return -ENOENT;
	}

	passkey = shell_strtoul(argv[1], 0, &err);
	if (err || passkey > 999999U) {
		shell_error(sh, "Passkey must be 0-999999");
		return -EINVAL;
	}

	err = bt_conn_auth_passkey_entry(pairing_conn, passkey);
	if (err) {
		shell_error(sh, "Passkey entry failed (%d)", err);
	}

	return err;
}

SHELL_STATIC_SUBCMD_SET_CREATE(
	pairing_cmds,
	SHELL_CMD(list, NULL, "List pairing modes", cmd_pairing_list),
	SHELL_CMD(show, NULL, "Show active pairing mode", cmd_pairing_show),
	SHELL_CMD(set, NULL, "Set pairing mode: pairing set <mode>", cmd_pairing_set),
	SHELL_CMD(confirm, NULL, "Confirm passkey or Just Works pairing", cmd_pairing_confirm),
	SHELL_CMD(passkey, NULL, "Enter passkey: pairing passkey <pin>", cmd_pairing_passkey),
	SHELL_SUBCMD_SET_END);

SHELL_CMD_REGISTER(pairing, &pairing_cmds, "Bluetooth pairing mode control", NULL);

void pairing_mode_shell_init(void)
{
	/* Commands registered via SHELL_CMD_REGISTER. */
}

#else /* !CONFIG_SHELL */

void pairing_mode_shell_init(void)
{
}

#endif /* CONFIG_SHELL */
```

## src/pairing_mode.h
```c
/*
 * Copyright (c) 2026 Nordic Semiconductor ASA
 *
 * SPDX-License-Identifier: LicenseRef-Nordic-5-Clause
 */

/**
 * @file pairing_mode.h
 * @brief Runtime selection of Bluetooth LE SMP pairing methods.
 *
 * A single pairing "mode" is kept until the application changes it (shell:
 * ``pairing set <mode>``). Each mode maps to one of the standard SMP pairing
 * methods defined in Bluetooth Core Specification Vol. 3, Part H (e.g. Just
 * Works, Passkey Entry, Numeric Comparison, OOB).
 *
 * The Zephyr host does not expose a direct "set pairing method" API. The final
 * method is negotiated from Pairing Request/Response fields (IO capability,
 * OOB data flag, AuthReq) on both peers. This module steers that negotiation
 * through three coordinated mechanisms:
 *
 * 1. **IO capability** — Which @ref bt_conn_auth_cb handlers are registered.
 *    Zephyr derives IO capability from non-NULL callbacks (see get_io_capa()
 *    in subsys/bluetooth/host/smp.c). Different auth_cb_* structures are
 *    swapped in pairing_mode_set() so the peripheral advertises the IO caps
 *    that match the desired method (e.g. DisplayYesNo → Numeric Comparison).
 *
 * 2. **SMP OOB flags** — bt_le_oob_set_sc_flag() / bt_le_oob_set_legacy_flag()
 *    control the OOB bit in our Pairing Response. If either peer sets OOB,
 *    the stack selects LE SC OOB or Legacy OOB instead of Just Works.
 *    pairing_mode_apply() sets these flags from the active mode.
 *
 * 3. **NFC Connection Handover** — pairing_mode_fill_oob_rec() and
 *    pairing_mode_nfc_includes_*() decide whether the static/TNEP NDEF LE OOB
 *    record includes le_sc_data and/or legacy TK. That tells the NFC poller
 *    what to expect before BLE connects. main.c calls pairing_mode_nfc_refresh()
 *    after a mode change to rebuild the tag message.
 *
 * During an active pairing, optional callbacks supply secrets when the stack
 * requests them (oob_data_request → main.c lesc_oob_data_set / legacy_tk_set),
 * or prompt via the shell (passkey_display / passkey_confirm / passkey_entry).
 * pairing_accept() rejects incompatible peer features for the selected mode.
 *
 * See pairing_mode.c for the mode → auth_cb / SMP / NFC mapping table.
 */

#ifndef PAIRING_MODE_H_
#define PAIRING_MODE_H_

#include <nfc/ndef/le_oob_rec.h>
#include <stdbool.h>

#include <zephyr/bluetooth/bluetooth.h>
#include <zephyr/bluetooth/conn.h>

/**
 * Application-selected pairing policy.
 *
 * Names align with shell commands (pairing set <name>). Each value targets a
 * specific SMP pairing method when the peer supports a compatible feature set.
 */
enum pairing_mode_id {
	/**
	 * LE Secure Connections + Just Works.
	 * SMP: No OOB flags; IO = NoInputNoOutput (auth_cb_none).
	 * NFC: Address/name only, no OOB fields in NDEF.
	 */
	PAIRING_MODE_LESC_JUST_WORKS = 0,
	/**
	 * LE Secure Connections + OOB (typical NFC touch-to-pair).
	 * SMP: sc_oobd_present; oob_data_request supplies SC OOB data.
	 * NFC: le_sc_data in LE OOB record; TNEP may exchange remote OOB.
	 */
	PAIRING_MODE_LESC_OOB,
	/**
	 * Legacy pairing + Just Works (no LE SC).
	 * SMP: No OOB, no SC; pairing_accept rejects peer SC.
	 */
	PAIRING_MODE_LEGACY_JUST_WORKS,
	/**
	 * Legacy pairing + OOB (16-byte TK over NFC).
	 * SMP: legacy_oobd_present; legacy TK via oob_data_request.
	 * NFC: tk_value in LE OOB record.
	 */
	PAIRING_MODE_LEGACY_OOB,
	/**
	 * LE Secure Connections + Numeric Comparison.
	 * SMP: IO = DisplayYesNo (passkey_display + passkey_confirm).
	 * User confirms matching 6-digit value: pairing confirm.
	 */
	PAIRING_MODE_LESC_NUMERIC_COMP,
	/**
	 * LE Secure Connections + Passkey Entry (this device inputs PIN).
	 * SMP: IO = KeyboardOnly (passkey_entry).
	 * User enters PIN: pairing passkey <pin>.
	 */
	PAIRING_MODE_LESC_PASSKEY_INPUT,
	/**
	 * LE Secure Connections + Passkey Entry (this device displays PIN).
	 * SMP: IO = DisplayOnly (passkey_display).
	 */
	PAIRING_MODE_LESC_PASSKEY_DISPLAY,
	PAIRING_MODE_COUNT,
};

/**
 * OOB secret handlers implemented in main.c (NFC sample).
 *
 * Called from auth_oob_data_request() when the stack starts LE SC OOB or
 * Legacy OOB pairing and needs local/remote OOB material.
 */
struct pairing_mode_oob_ops {
	void (*lesc_oob_set)(struct bt_conn *conn, struct bt_conn_oob_info *oob_info);
	void (*legacy_tk_set)(struct bt_conn *conn);
	/**
	 * @brief True if LE SC OOB data for @p conn's peer was received (e.g. over TNEP).
	 */
	bool (*remote_sc_oob_matches)(struct bt_conn *conn);
	/** @brief True if any peer SC OOB is stored (controls SMP OOB flag before pairing). */
	bool (*remote_sc_oob_ready)(void);
};

/** Register OOB ops and select default mode (PAIRING_MODE_LESC_OOB). */
int pairing_mode_init(const struct pairing_mode_oob_ops *ops);

/** Return the mode last applied with pairing_mode_set(). */
enum pairing_mode_id pairing_mode_get(void);

/**
 * Select pairing mode (persists until the next pairing_mode_set()).
 *
 * Registers matching auth callbacks, updates SMP OOB flags, and optionally
 * rebuilds the NFC NDEF via @p nfc_refresh (use pairing_mode_nfc_refresh).
 */
int pairing_mode_set(enum pairing_mode_id mode, int (*nfc_refresh)(void));

/**
 * Set LE OOB NDEF fields per active mode.
 *
 * Called from tnep_initial_msg_encode() and carrier_prepare() in main.c.
 * Passing NULL for le_sc_data/tk_value omits that carrier from the NFC tag.
 */
void pairing_mode_fill_oob_rec(struct nfc_ndef_le_oob_rec_payload_desc *rec,
			       struct bt_le_oob_sc_data *le_sc_data,
			       uint8_t *tk_value);

/** Shell/log name for @p mode (e.g. "lesc_oob"). */
const char *pairing_mode_name(enum pairing_mode_id mode);

/** Regenerate OOB keys and rebuild initial TNEP NDEF (defined in main.c). */
int pairing_mode_nfc_refresh(void);

/**
 * Restore SMP OOB flags after pairing completes or fails.
 *
 * main.c calls this instead of clearing flags so the configured mode stays
 * in effect for the next connection.
 */
void pairing_mode_apply(void);

/** True when NDEF should contain le_sc_data (lesc_oob mode). */
bool pairing_mode_nfc_includes_sc_oob(void);

/** True when NDEF should contain tk_value (legacy_oob mode). */
bool pairing_mode_nfc_includes_legacy_oob(void);

/**
 * True when TNEP/static handover may set bt_le_oob_set_*_flag from peer NDEF.
 *
 * main.c oob_le_data_handle() ignores remote OOB unless this returns true.
 */
bool pairing_mode_accepts_remote_oob(void);

/** No-op unless CONFIG_SHELL (commands use SHELL_CMD_REGISTER). */
void pairing_mode_shell_init(void);

/**
 * @brief Confirm an in-progress pairing (passkey, numeric comparison, Just Works).
 *
 * Same as shell ``pairing confirm``. Intended for DK button handling in main.c.
 *
 * @retval 0 Success
 * @retval -ENOENT No pairing awaiting confirmation
 * @retval Negative Other error from the Bluetooth API
 */
int pairing_mode_user_confirm(void);

/** @brief True when a pairing is waiting for pairing_mode_user_confirm(). */
bool pairing_mode_confirm_pending(void);

#endif /* PAIRING_MODE_H_ */
```
