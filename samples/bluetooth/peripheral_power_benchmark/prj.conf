## CMakeLists.txt
```
#
# Copyright (c) 2025 Nordic Semiconductor ASA
#
# SPDX-License-Identifier: LicenseRef-Nordic-5-Clause
#
cmake_minimum_required(VERSION 3.20.0)

find_package(Zephyr REQUIRED HINTS $ENV{ZEPHYR_BASE})
project(peripheral_hr)

# NORDIC SDK APP START
target_sources(app PRIVATE
  src/main.c
)
# NORDIC SDK APP END
```

## Kconfig
```
#
# Copyright (c) 2025 Nordic Semiconductor
#
# SPDX-License-Identifier: LicenseRef-Nordic-5-Clause
#

source "Kconfig.zephyr"

menu "Peripheral Power Benchmark tests"

config TEST_ADV_NON_CONNECTABLE
	bool "Enable non-connectable advertising test"

config TEST_PERIPHERAL_CONNECTION
	bool "Enable peripheral connection test"
	default y if !TEST_ADV_NON_CONNECTABLE

config ADVERTISING_INTERVAL_30_MS
	bool "30 ms adverising interval"
	default y

config ADVERTISING_INTERVAL_100_MS
	bool "100 ms adverising interval"

config ADVERTISING_INTERVAL_200_MS
	bool "200 ms adverising interval"

config ADVERTISING_INTERVAL_2000_MS
	bool "2000 ms adverising interval"

config ADVERTISING_INTERVAL
	int "Interval of an advertising in 0.625ms steps"
	default 48 if ADVERTISING_INTERVAL_30_MS
	default 160 if ADVERTISING_INTERVAL_100_MS
	default 320 if ADVERTISING_INTERVAL_200_MS
	default 3200 if ADVERTISING_INTERVAL_2000_MS

endmenu
```

## prj.conf
```kconfig
#
# Copyright (c) 2025 Nordic Semiconductor
#
# SPDX-License-Identifier: LicenseRef-Nordic-5-Clause
#

CONFIG_NCS_SAMPLES_DEFAULTS=y

CONFIG_BT=y
CONFIG_BT_PERIPHERAL=y

CONFIG_BT_CTLR_PHY_CODED=y
CONFIG_BT_CTLR_ADV_EXT=y

CONFIG_BT_USER_PHY_UPDATE=y

CONFIG_CONSOLE=n
CONFIG_UART_CONSOLE=n
CONFIG_SERIAL=n
CONFIG_GPIO=n
CONFIG_BOOT_BANNER=n
CONFIG_LOG=n

# Prevent the host from auto-initiating these procedures as this causes
# unintended and hard-to-debug problems. For example, if a procedure is run at
# the same time as the link is disconnected (in rob_l2cap_001), there will be an
# error in the log.
CONFIG_BT_AUTO_PHY_UPDATE=n
CONFIG_BT_AUTO_DATA_LEN_UPDATE=n
CONFIG_BT_GAP_AUTO_UPDATE_CONN_PARAMS=n
```

## boards/nrf5340dk_nrf5340_cpuapp.conf
```kconfig
#
# Copyright (c) 2025 Nordic Semiconductor
#
# SPDX-License-Identifier: LicenseRef-Nordic-5-Clause
#

# Application core does not have BLE controller. Disable controller related options.
CONFIG_BT_CTLR_PHY_CODED=n
CONFIG_BT_CTLR_ADV_EXT=n
```

## boards/nrf54h20dk_nrf54h20_cpuapp.conf
```kconfig
#
# Copyright (c) 2025 Nordic Semiconductor
#
# SPDX-License-Identifier: LicenseRef-Nordic-5-Clause
#

# Application core does not have BLE controller. Disable controller related options.
# Enable power management for APP core
CONFIG_PM=y
CONFIG_PM_S2RAM=y
CONFIG_POWEROFF=y
CONFIG_PM_S2RAM_CUSTOM_MARKING=y

# Optionally Disable all configs that allow for printing on uart
CONFIG_CONSOLE=n
CONFIG_UART_CONSOLE=n
CONFIG_SERIAL=n
CONFIG_GPIO=n
CONFIG_BOOT_BANNER=n
```

## boards/nrf54h20dk_nrf54h20_cpuapp.overlay
```dts
/* cpuapp have automatic ownership to all gpiote130 signals.
 * Do not own 0, 1, 2 and 3 so the cpurad can use them. */

&gpiote130 {
    owned-channels = <4 5 6 7>;
};
```

## src/main.c
```c
/*
 * Copyright (c) 2025 Nordic Semiconductor ASA
 *
 * SPDX-License-Identifier: LicenseRef-Nordic-5-Clause
 */

/** @file
 *  @brief Peripheral Power Benchmark
 */
#include <stddef.h>
#include <string.h>
#include <errno.h>
#include <zephyr/kernel.h>
#include <zephyr/types.h>
#include <zephyr/sys/printk.h>

#include <zephyr/bluetooth/bluetooth.h>
#include <zephyr/bluetooth/conn.h>
#include <zephyr/bluetooth/hci.h>

// Short name to be used for tests of a connection
#define DEVICE_NAME             "nRF-PM"
#define DEVICE_NAME_LEN         (sizeof(DEVICE_NAME) - 1)

static const struct bt_data ad[] = {
#if defined(CONFIG_TEST_PERIPHERAL_CONNECTION)
	BT_DATA_BYTES(BT_DATA_FLAGS, (BT_LE_AD_GENERAL | BT_LE_AD_NO_BREDR)),
	BT_DATA(BT_DATA_NAME_COMPLETE, DEVICE_NAME, DEVICE_NAME_LEN)
#endif /* CONFIG_TEST_PERIPHERAL_CONNECTION */
};

static struct bt_le_adv_param m_adv_param =	BT_LE_ADV_PARAM_INIT(
#if defined(CONFIG_TEST_PERIPHERAL_CONNECTION)
		BT_LE_ADV_OPT_CONN,
#else
		BT_LE_ADV_OPT_NONE,
#endif /* CONFIG_TEST_PERIPHERAL_CONNECTION */
		CONFIG_ADVERTISING_INTERVAL,
		CONFIG_ADVERTISING_INTERVAL,
		NULL);

static void connected(struct bt_conn *conn, uint8_t conn_err)
{
	char addr[BT_ADDR_LE_STR_LEN];

	bt_addr_le_to_str(bt_conn_get_dst(conn), addr, sizeof(addr));

	if (conn_err) {
		printk("Connection failed, err 0x%02x %s\n", conn_err, bt_hci_err_to_str(conn_err));
		return;
	}

	printk("Connected to: %s\n", addr);
}

static void disconnected(struct bt_conn *conn, uint8_t reason)
{
	int err;

	printk("Disconnected, reason 0x%02x %s\n", reason, bt_hci_err_to_str(reason));

	err = bt_le_adv_start(&m_adv_param, ad, ARRAY_SIZE(ad), NULL, 0);
	if (err) {
		printk("Advertising restart failed to start (err %d)\n", err);
		return;
	}
}

BT_CONN_CB_DEFINE(conn_callbacks) = {
	.connected = connected,
	.disconnected = disconnected,
};

int main(void)
{
	int err;

	printk("Starting Bluetooth Peripheral Power Benchmark\n");

	err = bt_enable(NULL);
	if (err) {
		printk("Bluetooth init failed (err %d)\n", err);
		return 0;
	}

	printk("Bluetooth initialized\n");

	err = bt_le_adv_start(&m_adv_param, ad, ARRAY_SIZE(ad), NULL, 0);
	if (err) {
		printk("Advertising failed to start (err %d)\n", err);
		return 0;
	}

	for (;;) {
		k_sleep(K_FOREVER);
	}
}
```
