## Kconfig
```
#
# Copyright (c) 2025 Nordic Semiconductor
#
# SPDX-License-Identifier: LicenseRef-Nordic-5-Clause
#

source "Kconfig.zephyr"

menu "Peripheral Power Benchmark tests"

config TEST_ADV_CONNECTABLE
	bool "Enable non-connectable advertising test"

config TEST_PERIPHERAL_CONNECTION
	bool "Enable peripheral connection test"
	default y if !TEST_ADV_CONNECTABLE

config ADVERTISING_INTERVAL_30_MS
	bool "30 ms adverising interval"
	default y

config ADVERTISING_INTERVAL_100_MS
	bool "100 ms adverising interval"

config ADVERTISING_INTERVAL_200_MS
	bool "200 ms adverising interval"

config ADVERTISING_INTERVAL_2000_MS
	bool "2000 ms adverising interval"

config ADVERTISING_INTERVAL
	int "Interval of an advertising in 0.625ms steps"
	default 48 if ADVERTISING_INTERVAL_30_MS
	default 160 if ADVERTISING_INTERVAL_100_MS
	default 320 if ADVERTISING_INTERVAL_200_MS
	default 3200 if ADVERTISING_INTERVAL_2000_MS

endmenu
```

## sample.yaml
```
sample:
  description: Bluetooth Low Energy peripheral heart rate service connecting on LE
    Coded PHY
  name: Bluetooth LE peripheral HR Coded
tests:
  sample.bluetooth.peripheral_hr_coded:
    sysbuild: true
    build_only: true
    integration_platforms:
      - nrf52840dk/nrf52840
      - nrf5340dk/nrf5340/cpuapp
      - nrf54l15dk/nrf54l15/cpuapp
      - nrf54h20dk/nrf54h20/cpuapp
    platform_allow: nrf52840dk/nrf52840 nrf5340dk/nrf5340/cpuapp nrf54l15dk/nrf54l15/cpuapp
      nrf54h20dk/nrf54h20/cpuapp
    tags: bluetooth ci_build sysbuild
  
  sample.bluetooth.peripheral_hr_coded.pm_enabled.mram_latency_off:
    sysbuild: true
    build_only: true
    platform_allow:
      - nrf54h20dk/nrf54h20/cpuapp
    integration_platforms:
      - nrf54h20dk/nrf54h20/cpuapp
    extra_args:
      CONFIG_PM=y CONFIG_PM_S2RAM=y CONFIG_POWEROFF=y CONFIG_PM_S2RAM_CUSTOM_MARKING=y
      CONFIG_CONSOLE=n CONFIG_UART_CONSOLE=n CONFIG_SERIAL=n CONFIG_GPIO=n CONFIG_BOOT_BANNER=n
      ipc_radio_CONFIG_PM=y ipc_radio_CONFIG_POWEROFF=y ipc_radio_CONFIG_CONSOLE=n
      ipc_radio_CONFIG_UART_CONSOLE=n ipc_radio_CONFIG_SERIAL=n ipc_radio_CONFIG_GPIO=n
      ipc_radio_CONFIG_BOOT_BANNER=n ipc_radio_CONFIG_MRAM_LATENCY_AUTO_REQ=n
    tags: bluetooth ci_build sysbuild

  sample.bluetooth.peripheral_hr_coded.pm_enabled.mram_latency_on:
    sysbuild: true
    build_only: true
    platform_allow:
      - nrf54h20dk/nrf54h20/cpuapp
    integration_platforms:
      - nrf54h20dk/nrf54h20/cpuapp
    extra_args:
      CONFIG_PM=y CONFIG_PM_S2RAM=y CONFIG_POWEROFF=y CONFIG_PM_S2RAM_CUSTOM_MARKING=y
      CONFIG_CONSOLE=n CONFIG_UART_CONSOLE=n CONFIG_SERIAL=n CONFIG_GPIO=n CONFIG_BOOT_BANNER=n
      ipc_radio_CONFIG_PM=y ipc_radio_CONFIG_POWEROFF=y ipc_radio_CONFIG_CONSOLE=n
      ipc_radio_CONFIG_UART_CONSOLE=n ipc_radio_CONFIG_SERIAL=n ipc_radio_CONFIG_GPIO=n
      ipc_radio_CONFIG_BOOT_BANNER=n
    tags: bluetooth ci_build sysbuild

  sample.bluetooth.peripheral_hr_coded.pm_enabled.no_pm_radio:
    sysbuild: true
    build_only: true
    platform_allow:
      - nrf54h20dk/nrf54h20/cpuapp
    integration_platforms:
      - nrf54h20dk/nrf54h20/cpuapp
    extra_args:
      CONFIG_PM=y CONFIG_PM_S2RAM=y CONFIG_POWEROFF=y CONFIG_PM_S2RAM_CUSTOM_MARKING=y
      CONFIG_CONSOLE=n CONFIG_UART_CONSOLE=n CONFIG_SERIAL=n CONFIG_GPIO=n CONFIG_BOOT_BANNER=n
      ipc_radio_CONFIG_CONSOLE=n
      ipc_radio_CONFIG_UART_CONSOLE=n ipc_radio_CONFIG_SERIAL=n ipc_radio_CONFIG_GPIO=n
      ipc_radio_CONFIG_BOOT_BANNER=n ipc_radio_CONFIG_MRAM_LATENCY_AUTO_REQ=n
    tags: bluetooth ci_build sysbuild
```

## prj.conf
```kconfig
#
# Copyright (c) 2020 Nordic Semiconductor
#
# SPDX-License-Identifier: LicenseRef-Nordic-5-Clause
#

#CONFIG_NCS_SAMPLES_DEFAULTS=n
#CONFIG_DK_LIBRARY=n

CONFIG_BT=y
CONFIG_BT_PERIPHERAL=y
CONFIG_BT_DEVICE_NAME="Nordic_HRS"

# Prevent the host from auto-initiating these procedures as this causes
# unintended and hard-to-debug problems. For example, if a procedure is run at
# the same time as the link is disconnected (in rob_l2cap_001), there will be an
# error in the log.
CONFIG_BT_AUTO_PHY_UPDATE=n
CONFIG_BT_AUTO_DATA_LEN_UPDATE=n
CONFIG_BT_GAP_AUTO_UPDATE_CONN_PARAMS=n
```

## boards/nrf54h20dk_nrf54h20_cpuapp.conf
```kconfig
#
# Copyright (c) 2024 Nordic Semiconductor
#
# SPDX-License-Identifier: LicenseRef-Nordic-5-Clause
#

# Application core does not have BLE controller. Disable controller related options.
CONFIG_BT_CTLR_PHY_CODED=n
CONFIG_BT_CTLR_ADV_EXT=n

CONFIG_PM=y
CONFIG_PM_S2RAM=y
CONFIG_POWEROFF=y
CONFIG_PM_S2RAM_CUSTOM_MARKING=y
CONFIG_CONSOLE=n
CONFIG_UART_CONSOLE=n
CONFIG_SERIAL=n
CONFIG_GPIO=n
CONFIG_BOOT_BANNER=n
```

## boards/nrf54h20dk_nrf54h20_cpuapp.overlay
```dts
/*
 * Copyright (c) 2024 Nordic Semiconductor ASA
 *
 * SPDX-License-Identifier: LicenseRef-Nordic-5-Clause
 */

//  / {
// 	power-states {
// 		idle: idle {
// 			compatible = "zephyr,power-state";
// 			power-state-name = "suspend-to-idle";
// 			min-residency-us = <100000>;
// 		};

// 		s2ram: s2ram {
// 			compatible = "zephyr,power-state";
// 			power-state-name = "suspend-to-ram";
// 			min-residency-us = <800000>;
// 		};
// 	};
//  };

//  &cpu {
// 	cpu-power-states = <&idle &s2ram>;
//  };
```

## src/main.c
```c
/*
 * Copyright (c) 2020 Nordic Semiconductor ASA
 *
 * SPDX-License-Identifier: LicenseRef-Nordic-5-Clause
 */

/** @file
 *  @brief Peripheral Heart Rate over LE Coded PHY sample
 */
#include <stddef.h>
#include <string.h>
#include <errno.h>
#include <zephyr/kernel.h>
#include <zephyr/types.h>
#include <zephyr/sys/printk.h>

#include <zephyr/bluetooth/bluetooth.h>
#include <zephyr/bluetooth/conn.h>
#include <zephyr/bluetooth/hci.h>

// Short name to be used for tests of a connection
#define DEVICE_NAME	"nRF-HRS"
#define DEVICE_NAME_LEN (sizeof(DEVICE_NAME) - 1)

static const struct bt_data ad[] = {
#if defined(CONFIG_TEST_PERIPHERAL_CONNECTION)
	BT_DATA_BYTES(BT_DATA_FLAGS, (BT_LE_AD_GENERAL | BT_LE_AD_NO_BREDR)),
	BT_DATA(BT_DATA_NAME_COMPLETE, DEVICE_NAME, DEVICE_NAME_LEN)
#endif /* CONFIG_TEST_PERIPHERAL_CONNECTION */
};

static struct bt_le_adv_param m_adv_param = BT_LE_ADV_PARAM_INIT(
#if defined(CONFIG_TEST_PERIPHERAL_CONNECTION)
	BT_LE_ADV_OPT_CONN,
#else
	BT_LE_ADV_OPT_NONE,
#endif /* CONFIG_TEST_PERIPHERAL_CONNECTION */
	CONFIG_ADVERTISING_INTERVAL, CONFIG_ADVERTISING_INTERVAL, NULL);

static void connected(struct bt_conn *conn, uint8_t conn_err)
{
	char addr[BT_ADDR_LE_STR_LEN];

	bt_addr_le_to_str(bt_conn_get_dst(conn), addr, sizeof(addr));

	if (conn_err) {
		printk("Connection failed, err 0x%02x %s\n", conn_err, bt_hci_err_to_str(conn_err));
		return;
	}

	printk("Connected to: %s\n", addr);
}

static void disconnected(struct bt_conn *conn, uint8_t reason)
{
	int err;

	printk("Disconnected, reason 0x%02x %s\n", reason, bt_hci_err_to_str(reason));

	err = bt_le_adv_start(&m_adv_param, ad, ARRAY_SIZE(ad), NULL, 0);
	if (err) {
		printk("Advertising restart failed to start (err %d)\n", err);
		return;
	}
}

BT_CONN_CB_DEFINE(conn_callbacks) = {
	.connected = connected,
	.disconnected = disconnected,
};

int main(void)
{
	int err;

	printk("Starting Bluetooth Peripheral Power Benchmark\n");

	err = bt_enable(NULL);
	if (err) {
		printk("Bluetooth init failed (err %d)\n", err);
		return 0;
	}

	printk("Bluetooth initialized\n");

	err = bt_le_adv_start(&m_adv_param, ad, ARRAY_SIZE(ad), NULL, 0);
	if (err) {
		printk("Advertising failed to start (err %d)\n", err);
		return 0;
	}

	printk("Advertising started\n");

	for (;;) {
		k_sleep(K_FOREVER);
	}
}
```
